/* USER CODE BEGIN Header */
/**
  ******************************************************************************
  * @file           : main.c
  * @brief          : Main program body
  ******************************************************************************
  * @attention
  *
  * <h2><center>&copy; Copyright (c) 2020 STMicroelectronics.
  * All rights reserved.</center></h2>
  *
  * This software component is licensed by ST under BSD 3-Clause license,
  * the "License"; You may not use this file except in compliance with the
  * License. You may obtain a copy of the License at:
  *                        opensource.org/licenses/BSD-3-Clause
  *
  ******************************************************************************
  */
/* USER CODE END Header */
/* Includes ------------------------------------------------------------------*/
#include "main.h"
#include "gpio.h"
#include "fsmc.h"

/* Private includes ----------------------------------------------------------*/
/* USER CODE BEGIN Includes */
#include "stdbool.h"
#include "math.h"
#include "stdlib.h"
#include "string.h"
#include "lcd_explay_n1.h"
/* USER CODE END Includes */

/* Private typedef -----------------------------------------------------------*/
/* USER CODE BEGIN PTD */

/* USER CODE END PTD */

/* Private define ------------------------------------------------------------*/
/* USER CODE BEGIN PD */


/* USER CODE END PD */

/* Private macro -------------------------------------------------------------*/
/* USER CODE BEGIN PM */


/* USER CODE END PM */

/* Private variables ---------------------------------------------------------*/

/* USER CODE BEGIN PV */
// SmallFont.c
// Modified by Alexey Stepanov (cyrillic symbols added)
// Font Size	: 8x12
// Memory usage	: 1720 bytes
// # characters	: 144
// offset       : 32
const uint8_t SmallFont[2008] ={
//0x08,0x0C,0x20,0x8F,
0x08,0x0C,0x20,0xA6,
0x00,0x00,0x00,0x00,0x00,0x00,0x00,0x00,0x00,0x00,0x00,0x00, // <Space>
0x00,0x00,0x20,0x20,0x20,0x20,0x20,0x20,0x00,0x20,0x00,0x00, // !
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0x00,0x00,0xFF,0xFF,0xFF,0xFF,0xFF,0xFF,0xFF,0xFF,0x00,0x00, // квадрат полный 198	0xC6
};

// BigFont.c (C)2010 by Henning Karlsen
// Font Size	: 16x16
// Memory usage	: 3044 bytes
// # characters	: 95
const uint8_t BigFont[4612] ={
0x10,0x10,0x20,0x8F,
0x00,0x00,0x00,0x00,0x00,0x00,0x00,0x00,0x00,0x00,0x00,0x00,0x00,0x00,0x00,0x00,0x00,0x00,0x00,0x00,0x00,0x00,0x00,0x00,0x00,0x00,0x00,0x00,0x00,0x00,0x00,0x00, //  <Space>
0x00,0x00,0x00,0x00,0x07,0x00,0x0F,0x80,0x0F,0x80,0x0F,0x80,0x0F,0x80,0x0F,0x80,0x07,0x00,0x07,0x00,0x00,0x00,0x00,0x00,0x07,0x00,0x07,0x00,0x07,0x00,0x00,0x00, // !
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0x00,0x00,0x00,0x00,0x00,0x00,0x00,0x00,0x00,0x00,0x00,0x00,0x07,0xF8,0x0E,0x38,0x0E,0x38,0x0E,0x38,0x07,0xF8,0x0E,0x38,0x0E,0x38,0x1C,0x38,0x00,0x00,0x00,0x00, // я
};

// SevenSegNumFont.c
// Font Size	: 32x50
// Memory usage	: 2004 bytes
// # characters	: 10
const uint8_t SevenSegNumFont[2004] ={
0x20,0x32,0x30,0x0A,
0x00,0x00,0x00,0x00,0x00,0x00,0x00,0x00,0x00,0xFF,0xFE,0x00,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0x00,  // 0
0x00,0x00,0x00,0x00,0x00,0x00,0x00,0x00,0x00,0x00,0x00,0x00,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0x00,  // 1
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0x00,0x00,0x00,0x00,0x00,0x00,0x00,0x00,0x00,0xFF,0xFE,0x00,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0x00,  // 9
};

/* USER CODE END PV */

/* Private function prototypes -----------------------------------------------*/
void SystemClock_Config(void);
/* USER CODE BEGIN PFP */

/* USER CODE END PFP */

/* Private user code ---------------------------------------------------------*/
/* USER CODE BEGIN 0 */


/* USER CODE END 0 */

/**
  * @brief  The application entry point.
  * @retval int
  */
int main(void)
{
  /* USER CODE BEGIN 1 */

  /* USER CODE END 1 */

  /* MCU Configuration--------------------------------------------------------*/

  /* Reset of all peripherals, Initializes the Flash interface and the Systick. */
  HAL_Init();

  /* USER CODE BEGIN Init */

  /* USER CODE END Init */

  /* Configure the system clock */
  SystemClock_Config();

  /* USER CODE BEGIN SysInit */
  srand (HAL_GetTick());
  /* USER CODE END SysInit */

  /* Initialize all configured peripherals */
  MX_GPIO_Init();
  MX_FSMC_Init();
  /* USER CODE BEGIN 2 */

  InitLCD();
  setFont(SmallFont);
  uint16_t buf[478];
  uint16_t x, x2;
  uint16_t y, y2;
  uint16_t r;
  sprintf(buf,"%d",x);
// Clear the screen and draw the frame


  /* USER CODE END 2 */

  /* Infinite loop */
  /* USER CODE BEGIN WHILE */
  while (1)
  {
    /* USER CODE END WHILE */

    /* USER CODE BEGIN 3 */
	//******************************************************************************************************************
	LCD_clrScr();
	setColorRGB(255, 0, 0);
	fillRect(0, 0, 479, 13);
	setColorRGB(64, 64, 64);
	fillRect(0, 306, 479, 319);
	setColorRGB(255, 255, 255);
	setBackColorRGB(255, 0, 0);
	print("* Universal Color TFT Display Library *", CENTER, 1,0);
	setBackColorRGB(64, 64, 64);
	setColorRGB(255,255,0);
	print("<http://electronics.henningkarlsen.com>", CENTER, 307,0);
    setColorRGB(0, 0, 255);
    drawRect(0, 14, 479, 305);
// Draw crosshairs
    setColorRGB(0, 0, 255);
    setBackColorRGB(0, 0, 0);
    drawLine(239, 15, 239, 304);
    drawLine(1, 159, 478, 159);
    for (int i=9; i<470; i+=10)
    	drawLine(i, 157, i, 161);
    for (int i=19; i<220; i+=10)
    	drawLine(237, i, 241, i);
// Draw sin-, cos- and tan-lines
    setColorRGB(0,255,255);
    print("Sin", 5, 15,0);
    for (int i=1; i<478; i++){
      drawPixel(i,159+(sin(((i*1.13)*3.14)/180)*95));
    }
    setColorRGB(255,0,0);
    print("Cos", 5, 27,0);
    for (int i=1; i<478; i++){
      drawPixel(i,159+(cos(((i*1.13)*3.14)/180)*95));
    }
    setColorRGB(255,255,0);
    print("Tan", 5, 39,0);
    for (int i=1; i<478; i++){
      drawPixel(i,159+(tan(((i*1.13)*3.14)/180)));
    }
    HAL_Delay(1000);
    setColorRGB(0,0,0);
    fillRect(1,15,478,304);
    setColorRGB(0, 0, 255);
    setBackColorRGB(0, 0, 0);
    drawLine(239, 15, 239, 304);
    drawLine(1, 159, 478, 159);
// Draw a moving sinewave
     x=1;
      for (int i=1; i<(478*15); i++){
        x++;
        if (x==479)
          x=1;
        if (i>479)
        {
          if ((x==239)||(buf[x-1]==159))
          	setColorRGB(0,0,255);
          else
          	setColorRGB(0,0,0);
          drawPixel(x,buf[x-1]);
        }
        setColorRGB(0,255,255);
        y=159+(sin(((i*0.7)*3.14)/180)*(90-(i / 100)));
        drawPixel(x,y);
        buf[x-1]=y;
      }
 //-------------------------------------------------------------------------------------------------
    HAL_Delay(1000);
    setColorRGB(0,0,0);
    fillRect(1,15,478,304);
// Draw some filled rectangles
    for (int i=1; i<6; i++){
      switch (i)
      {
        case 1:
          setColorRGB(255,0,255);
          break;
        case 2:
          setColorRGB(255,0,0);
          break;
        case 3:
          setColorRGB(0,255,0);
          break;
        case 4:
          setColorRGB(0,0,255);
          break;
        case 5:
          setColorRGB(255,255,0);
          break;
      }
      fillRect(150+(i*20), 70+(i*20), 210+(i*20), 130+(i*20));
    }
    HAL_Delay(1000);
    setColorRGB(0,0,0);
    fillRect(1,15,478,304);
// Draw some filled, rounded rectangles
    for (int i=1; i<6; i++){
      switch (i)
      {
        case 1:
          setColorRGB(255,0,255);
          break;
        case 2:
          setColorRGB(255,0,0);
          break;
        case 3:
          setColorRGB(0,255,0);
          break;
        case 4:
          setColorRGB(0,0,255);
          break;
        case 5:
          setColorRGB(255,255,0);
          break;
      }
      fillRoundRect(270-(i*20), 70+(i*20), 330-(i*20), 130+(i*20));
    }
    HAL_Delay(1000);
    setColorRGB(0,0,0);
    fillRect(1,15,478,304);
// Draw some filled circles
    for (int i=1; i<6; i++){
      switch (i)
      {
        case 1:
      	  setColorRGB(255,0,255);
          break;
        case 2:
       	  setColorRGB(255,0,0);
          break;
        case 3:
          setColorRGB(0,255,0);
          break;
        case 4:
          setColorRGB(0,0,255);
           break;
        case 5:
          setColorRGB(255,255,0);
          break;
      }
      fillCircle(180+(i*20),100+(i*20), 30);
    }
    HAL_Delay(1000);
    setColorRGB(0,0,0);
    fillRect(1,15,478,304);
// Draw some lines in a pattern
    setColorRGB(255,0,0);
    for (int i=15; i<304; i+=5){
    	drawLine(1, i, (i*1.6)-10, 304);
     }
     setColorRGB(255,0,0);
     for (int i=304; i>15; i-=5){
    	 drawLine(478, i, (i*1.6)-11, 15);
     }
     setColorRGB(0,255,255);
     for (int i=304; i>15; i-=5)      {
    	 drawLine(1, i, 491-(i*1.6), 15);
     }
     setColorRGB(0,255,255);
     for (int i=15; i<304; i+=5){
    	 drawLine(478, i, 490-(i*1.6), 304);
     }
     HAL_Delay(1000);
     setColorRGB(0,0,0);
     fillRect(1,15,478,304);
// Draw some random circles
     for (int i=0; i<100; i++){
    	  setColorRGB(rand()%255+1, rand()%255+1, rand()%255+1);
    	  x=32+rand()%416+1;
    	  y=45+rand()%226+1;
    	  r=rand()%30+1;
    	  drawCircle(x, y, r);
     }
     HAL_Delay(1000);
     setColorRGB(0,0,0);
     fillRect(1,15,478,304);
// Draw some random rectangles
     for (int i=0; i<100; i++){
    	   setColorRGB(random()%255+1, random()%255+1, random()%255+1);
    	   x=2+random()%476+1;
    	   y=16+random()%289+1;
    	   x2=2+random()%476+1;
    	   y2=16+random()%289+1;
    	   drawRect(x, y, x2, y2);
     }
     HAL_Delay(1000);
     setColorRGB(0,0,0);
     fillRect(1,15,478,304);
// Draw some random rounded rectangles
     for (int i=0; i<100; i++){
    	   setColorRGB(random()%255+1, random()%255+1, random()%255+1);
    	   x=2+random()%476+1;
    	   y=16+random()%289+1;
    	   x2=2+random()%476+1;
    	   y2=16+random()%289+1;
    	   drawRoundRect(x, y, x2, y2);
     }
	 HAL_Delay(1000);
	 setColorRGB(0,0,0);
     fillRect(1,15,478,304);
	 for (int i=0; i<100; i++){
		   setColorRGB(random()%255+1, random()%255+1, random()%255+1);
		   x=2+random()%476+1;
		   y=16+random()%289+1;
		   x2=2+random()%476+1;
		   y2=16+random()%289+1;
		   drawLine(x, y, x2, y2);
     }
	 HAL_Delay(1000);
	 setColorRGB(0,0,0);
     fillRect(1,15,478,304);
     for (int i=0; i<10000; i++){
    	   setColorRGB(random()%255+1, random()%255+1, random()%255+1);
    	   drawPixel(2+random()%476+1, 16+random()%289+1);
     }
     HAL_Delay(1000);
     setColorRGB(0, 0, 255);
     fillScr(f_color);
     setColorRGB(255, 0, 0);
     fillRoundRect(160, 70, 319, 169);
     setColorRGB(255, 255, 255);
     setBackColorRGB(255, 0, 0);
     print("That's it!", CENTER, 93,0);
     print("Restarting in a", CENTER, 119,0);
     print("few seconds...", CENTER, 132,0);
     setColorRGB(0, 255, 0);
     setBackColorRGB(0, 0, 255);
     print("Runtime: (msecs)", CENTER, 290,0);
     printNumI(0x7fffffff, CENTER, 305,0,' ');
     HAL_Delay (5000);
  }
  /* USER CODE END 3 */
}

/**
  * @brief System Clock Configuration
  * @retval None
  */
void SystemClock_Config(void)
{
  RCC_OscInitTypeDef RCC_OscInitStruct = {0};
  RCC_ClkInitTypeDef RCC_ClkInitStruct = {0};

  /** Initializes the RCC Oscillators according to the specified parameters
  * in the RCC_OscInitTypeDef structure.
  */
  RCC_OscInitStruct.OscillatorType = RCC_OSCILLATORTYPE_HSE;
  RCC_OscInitStruct.HSEState = RCC_HSE_ON;
  RCC_OscInitStruct.HSEPredivValue = RCC_HSE_PREDIV_DIV1;
  RCC_OscInitStruct.HSIState = RCC_HSI_ON;
  RCC_OscInitStruct.PLL.PLLState = RCC_PLL_ON;
  RCC_OscInitStruct.PLL.PLLSource = RCC_PLLSOURCE_HSE;
  RCC_OscInitStruct.PLL.PLLMUL = RCC_PLL_MUL9;
  if (HAL_RCC_OscConfig(&RCC_OscInitStruct) != HAL_OK)
  {
    Error_Handler();
  }
  /** Initializes the CPU, AHB and APB buses clocks
  */
  RCC_ClkInitStruct.ClockType = RCC_CLOCKTYPE_HCLK|RCC_CLOCKTYPE_SYSCLK
                              |RCC_CLOCKTYPE_PCLK1|RCC_CLOCKTYPE_PCLK2;
  RCC_ClkInitStruct.SYSCLKSource = RCC_SYSCLKSOURCE_PLLCLK;
  RCC_ClkInitStruct.AHBCLKDivider = RCC_SYSCLK_DIV1;
  RCC_ClkInitStruct.APB1CLKDivider = RCC_HCLK_DIV2;
  RCC_ClkInitStruct.APB2CLKDivider = RCC_HCLK_DIV1;

  if (HAL_RCC_ClockConfig(&RCC_ClkInitStruct, FLASH_LATENCY_2) != HAL_OK)
  {
    Error_Handler();
  }
}

/* USER CODE BEGIN 4 */

/* USER CODE END 4 */

/**
  * @brief  This function is executed in case of error occurrence.
  * @retval None
  */
void Error_Handler(void)
{
  /* USER CODE BEGIN Error_Handler_Debug */
  /* User can add his own implementation to report the HAL error return state */

  /* USER CODE END Error_Handler_Debug */
}

#ifdef  USE_FULL_ASSERT
/**
  * @brief  Reports the name of the source file and the source line number
  *         where the assert_param error has occurred.
  * @param  file: pointer to the source file name
  * @param  line: assert_param error line source number
  * @retval None
  */
void assert_failed(uint8_t *file, uint32_t line)
{
  /* USER CODE BEGIN 6 */
  /* User can add his own implementation to report the file name and line number,
     tex: printf("Wrong parameters value: file %s on line %d\r\n", file, line) */
  /* USER CODE END 6 */
}
#endif /* USE_FULL_ASSERT */

/************************ (C) COPYRIGHT STMicroelectronics *****END OF FILE****/
